## system1_rgb_led/drivers/rgb_led/Kconfig
```kconfig
config CUSTOM_RGB_LED
	bool "Custom RGB LED driver"
	default y
	depends on GPIO
	help
	  Enable the custom RGB LED driver that lights a single dominant
	  channel (red, green, or blue) based on a 24-bit hex color value
	  received over the console.
```

## system2_servo/drivers/servo/Kconfig
```kconfig
config CUSTOM_SERVO
	bool "Custom servo driver"
	default y
	depends on PWM
	help
	  Enable the custom servo driver that maps a 0-180 degree value to a
	  PWM pulse width between min-pulse-us and max-pulse-us.
```

## system2_servo/dts/bindings/misc/custom,servo.yaml
```yaml
description: |
  Custom servo driver controlled via PWM pulse width, matching a typical
  hobby servo (500-2400us pulses at 50Hz), ported from Arduino's
  ESP32Servo library usage.

compatible: "custom,servo"

properties:
  pwms:
    type: phandle-array
    required: true
    description: PWM output driving the servo signal wire

  min-pulse-us:
    type: int
    default: 500
    description: Pulse width in microseconds corresponding to 0 degrees

  max-pulse-us:
    type: int
    default: 2400
    description: Pulse width in microseconds corresponding to 180 degrees
```

## system3_tone/drivers/tone/Kconfig
```kconfig
config CUSTOM_TONE
	bool "Custom tone driver"
	default y
	depends on PWM && ADC
	help
	  Enable the custom tone driver that plays a PWM tone for a duration
	  derived from an ADC voltage reading.
```

## system4_comms/drivers/comms/Kconfig
```kconfig
config CUSTOM_COMMS
	bool "Custom comms driver"
	default y
	depends on SERIAL
	help
	  Enable the custom comms driver that wraps a UART controller to
	  receive an external byte value (0-255).
```
