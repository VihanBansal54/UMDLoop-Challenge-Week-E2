## CMakeLists.txt
```
cmake_minimum_required(VERSION 3.20.0)

find_package(Zephyr REQUIRED HINTS $ENV{ZEPHYR_BASE})
project(system_one_rgb_led)

target_sources(app PRIVATE src/main.c)

if(CONFIG_CUSTOM_RGB_LED)
    target_sources(app PRIVATE drivers/rgb_led/rgb_led.c)
    target_include_directories(app PRIVATE drivers/rgb_led)
endif()
```

## Kconfig
```
source "Kconfig.zephyr"

rsource "drivers/rgb_led/Kconfig"
```

## prj.conf
```kconfig
CONFIG_GPIO=y
CONFIG_CONSOLE=y
CONFIG_UART_CONSOLE=y
CONFIG_CONSOLE_GETLINE=y
CONFIG_CUSTOM_RGB_LED=y
```

## boards/esp32_devkitc_esp32_procpu.overlay
```dts
/ {
	rgb_led0: rgb_led_0 {
		compatible = "custom,rgb-led";
		red-gpios   = <&gpio0 12 GPIO_ACTIVE_HIGH>;
		green-gpios = <&gpio0 13 GPIO_ACTIVE_HIGH>;
		blue-gpios  = <&gpio0 14 GPIO_ACTIVE_HIGH>;
	};
};
```

## dts/bindings/led/custom,rgb-led.yaml
```yaml
description: |
  RGB LED that takes hexcode values and flashes the colored led that is closest to that hex

compatible: "custom,rgb-led"

properties:
  red-gpios:
    type: phandle-array
    required: true
    description: GPIO connected to red LED

  green-gpios:
    type: phandle-array
    required: true
    description: GPIO connected to green LED

  blue-gpios:
    type: phandle-array
    required: true
    description: GPIO connected to blue LED
```

## src/main.c
```c
#include <zephyr/kernel.h>
#include <zephyr/device.h>
#include <zephyr/console/console.h>
#include <stdlib.h>
#include "../drivers/rgb_led/rgb_led.h"

#define RGB_LED_NODE DT_NODELABEL(rgb_led0)

int main(void)
{
	const struct device *rgb_led = DEVICE_DT_GET(RGB_LED_NODE);

	if (!device_is_ready(rgb_led)) {
		printk("RGB LED device not ready\n");
		return 0;
	}

	console_getline_init();
	printk("Enter a hex color (e.g. FF0000) and press enter:\n");

	while (1) {
		char *line = console_getline();
		uint32_t hex = (uint32_t)strtoul(line, NULL, 16);

		rgb_led_set_from_hex(rgb_led, hex);
		printk("Set color from hex: %06X\n", hex);
	}

	return 0;
}
```
