## CMakeLists.txt
```
cmake_minimum_required(VERSION 3.20.0)

find_package(Zephyr REQUIRED HINTS $ENV{ZEPHYR_BASE})
project(system_four_comms)

target_sources(app PRIVATE src/main.c)

if(CONFIG_CUSTOM_COMMS)
    target_sources(app PRIVATE drivers/comms/comms.c)
    target_include_directories(app PRIVATE drivers/comms)
endif()
```

## Kconfig
```
source "Kconfig.zephyr"

rsource "drivers/comms/Kconfig"
```

## prj.conf
```kconfig
CONFIG_SERIAL=y
CONFIG_CUSTOM_COMMS=y
```

## boards/esp32_devkitc_esp32_procpu.overlay
```dts
/ {
	comms0: comms_0 {
		compatible = "custom,comms";
		uart = <&uart0>;
	};
};
```

## dts/bindings/misc/custom,comms.yaml
```yaml
description: |
  Wraps an existing UART controller to receive an external byte value
  (0-255), matching the original design that read serial input over
  USART/USB.

compatible: "custom,comms"

properties:
  uart:
    type: phandle
    required: true
    description: UART controller used to receive external data
```

## src/main.c
```c
#include <zephyr/kernel.h>
#include <zephyr/device.h>
#include "../drivers/comms/comms.h"

#define COMMS_NODE DT_NODELABEL(comms0)

int main(void)
{
	const struct device *comms = DEVICE_DT_GET(COMMS_NODE);

	if (!device_is_ready(comms)) {
		printk("Comms device not ready\n");
		return 0;
	}

	printk("Waiting for external data (0-255)...\n");

	while (1) {
		uint8_t byte;

		if (comms_receive_byte(comms, &byte) == 0) {
			printk("Received value: %u\n", byte);
		}
		k_msleep(10);
	}

	return 0;
}
```
